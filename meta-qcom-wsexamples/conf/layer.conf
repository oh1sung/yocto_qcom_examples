## meta-qcom-wsexamples/conf/layer.conf
```bitbake
# We have a conf and classes directory, add to BBPATH
BBPATH .= ":${LAYERDIR}"

# We have recipes-* directories, add to BBFILES
BBFILES += "${LAYERDIR}/recipes-*/*/*.bb \
	${LAYERDIR}/recipes-*/*/*.bbappend"

BBFILE_COLLECTIONS += "qcom-wsexamples"
BBFILE_PATTERN_qcom-wsexamples = "^${LAYERDIR}/"
BBFILE_PRIORITY_qcom-wsexamples = "6"
```
